## boards/shields/nice_view_clouds/Kconfig.defconfig
```kconfig
if SHIELD_NICE_VIEW_CLOUDS

config LV_Z_VDB_SIZE
    default 100

config LV_DPI_DEF
    default 161

config LV_Z_BITS_PER_PIXEL
    default 1

choice LV_COLOR_DEPTH
    default LV_COLOR_DEPTH_1
endchoice

choice ZMK_DISPLAY_WORK_QUEUE
    default ZMK_DISPLAY_WORK_QUEUE_DEDICATED
endchoice

choice ZMK_DISPLAY_STATUS_SCREEN
    default ZMK_DISPLAY_STATUS_SCREEN_CUSTOM
endchoice

config LV_Z_MEM_POOL_SIZE
    default 4096 if ZMK_DISPLAY_STATUS_SCREEN_CUSTOM

config ZMK_DISPLAY_STATUS_SCREEN_CUSTOM
    imply NICE_VIEW_CLOUDS_SCREEN

config NICE_VIEW_CLOUDS_SCREEN
    bool "nice!view layer list (left) and cloud scene (right)"
    select LV_USE_IMG
    select LV_USE_CANVAS

config NICE_VIEW_CLOUDS_INVERTED
    bool "Swap the screen's ink and background colors"

config NICE_VIEW_CLOUDS_FLIP
    bool "Turn the screen image upside down"

config NICE_VIEW_CLOUDS_FRAME_MS
    int "Cloud animation frame time in ms (lower is smoother, uses more battery)"
    default 150

endif # SHIELD_NICE_VIEW_CLOUDS
```
